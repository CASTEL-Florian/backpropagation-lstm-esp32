/* THIS IS THE MAIN FOR AN 32 BIT LSTM */


#include "freertos/FreeRTOS.h"
#include "nvs_flash.h"
#include "driver/gpio.h"
#include "esp_spi_flash.h"
#include "esp_system.h"
#include "freertos/task.h"

#include <math.h>
#include "time.h"
#define PI 3.141592654
//#include "parameters32.h"
#include "lstm.h"

float time_series[TIME_SERIES_LEN] = {0.36800376, 0.44377467, 0.44579864, 0.4892158, 0.41918758, 0.43368587, 0.4195563, 0.45447323, 0.52435946, 0.35436207, 0.45200756, 0.42453113, 0.4379751,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 0.39184108, 0.4153896};


struct Mat* inputs[TRAIN_LEN];
struct Mat* targets[TRAIN_LEN];

void init(){
    for (int i = 0; i < SEQ_LEN; i++){
        cacheList[i] = (struct cache*)malloc(sizeof(struct cache));
    }
    a = newmat(1, 4*H, 0);
    prod_h_Wh = newmat(1, 4*H, 0);
    next_c = newmat(1, H, 0);
    next_h = newmat(1, H, 0);


    ig = newmat(1, H, 0);

    tanh_next_c = newmat(1, H, 0);

    prev_c = zeros(1, H);
    x_cur = newmat(1,INPUT_DIM,0);
    forward = (struct forward*)malloc(sizeof(struct forward));


    d1 = newmat(1, H, 0);
    one_matrix_H = ones(1,H);
    dop = newmat(1, H, 0);
    dprev_c = newmat(1,H,0);
    dfp = newmat(1,H,0);
    dip = newmat(1,H,0);
    dgp = newmat(1,H,0);
    do_ = newmat(1,H,0);
    df = newmat(1,H,0);
    di = newmat(1,H,0);
    dg = newmat(1,H,0);
    da = newmat(1,4 * H,0);
    db_step = newmat(1,4 * H,0);
    WxT = newmat(4*H, INPUT_DIM,0);
    WhT = newmat(4 * H, H,0);
    dx = newmat(1,INPUT_DIM,0);
    dprev_h = newmat(1,H,0);
    xT = newmat(INPUT_DIM, 1,0);
    dWx_step = newmat(INPUT_DIM,4 * H,0);
    prev_hT = newmat(H, 1,0);
    dWh_step = newmat(H, 4 * H, 0);
    step_backward = (struct step_backward*)malloc(sizeof(struct step_backward));

    dWx = newmat(INPUT_DIM,4 * H,0);
    dWh = newmat(H, 4*H, 0);
    dh_prev = newmat(1,H,0);
    dc_prev = newmat(1,H,0);
    db = newmat(1,4*H,0);


    prediction = newmat(1, OUTPUT_DIM, 0);


    prev_h = newmat(1,H,0); 
    dh_states = newmat(1,H,0);
    dWhy = newmat(OUTPUT_DIM,H,0);
    dby = newmat(1,OUTPUT_DIM,0);
    WhyT = newmat(H, OUTPUT_DIM, 0);
    scores = newmat(1, OUTPUT_DIM, 0);
    dscores = newmat(1, OUTPUT_DIM, 0);
    dscores2 = newmat(1, OUTPUT_DIM, 0);
    temp = newmat(1, OUTPUT_DIM, 0);
    one_matrix_O = ones(1,OUTPUT_DIM);
    backward = (struct backward*)malloc(sizeof(struct backward));

}


void create_training_data(){
    for(int i = 0; i < TRAIN_LEN; i++){
      inputs[i] = newmat(SEQ_LEN, 1, 0);
      targets[i] = newmat(1, OUTPUT_DIM, time_series[i + SEQ_LEN]);
      for(int k = 0; k < SEQ_LEN; k++){
        set(inputs[i], k + 1, 1, time_series[i + k]);
      }
    }
}

/*initialisation des poids avec des valeurs aléatoires*/
void init_weights(){
    Wh = randm(H, 4 * H, -1 / sqrtf(4 * H), 1 / sqrtf(4 * H));
    Wx = randm(INPUT_DIM, 4 * H, -1 / sqrtf(4 * H), 1 / sqrtf(4 * H));
    b = newmat(1, 4 * H,0);
    Why = randm(OUTPUT_DIM, H, -1 / sqrtf(H), 1 / sqrtf(H));
    by = newmat(1, OUTPUT_DIM, 0);
}





void app_main(void)
{
    printf("Hello world!\n");
    printf("sequence lenght : %d\n", SEQ_LEN);
    printf("hidden dimension : %d\n", H);
    init();
    init_weights();
    create_training_data();
    int nb_epochs = 100;
    clock_t begin = clock();

    float* loss_list = train(inputs, targets, INPUT_DIM, H, OUTPUT_DIM, TRAIN_LEN, SEQ_LEN, LEARNING_RATE, nb_epochs);
    printf("%s\n","loss :");
    float min_loss = loss_list[0];
    for(int i = 0; i<nb_epochs; i++){
        printf("%f\n",loss_list[i]);
        if (loss_list[i] < min_loss){
            min_loss = loss_list[i];
        }
    }
    clock_t end = clock();
    double time_spent = (double)(end - begin) / CLOCKS_PER_SEC;
    printf("min loss : %f\n", min_loss);
    printf("Time spent : %f\n", time_spent);

	printf("Restarting now.\n");
	fflush(stdout);
	esp_restart();

}




